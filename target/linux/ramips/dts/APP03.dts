/dts-v1/;

/include/ "APP03.dtsi"

/ {
	compatible = "JARXI,APP03", "ralink,mt7620a-soc";
	model = "JARXI APP03";

	ethernet@10100000 {
		pinctrl-names = "default";
		pinctrl-0 = <&ephy_pins>;
		mtd-mac-address = <&factory 0x2e>;
		ralink,port-map = "wllll";
	};
};
